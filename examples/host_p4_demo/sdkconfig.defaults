## examples/host_p4_demo/sdkconfig.defaults
```kconfig
CONFIG_IDF_TARGET="esp32p4"

# Hosted Wi-Fi (radio lives on a remote chip)
CONFIG_ESP_HOSTED_ENABLED=y
CONFIG_ESP_WIFI_ENABLED=y

# Peer-data RPC channel — required for esp_hosted_open custom RPCs
CONFIG_ESP_HOSTED_ENABLE_PEER_DATA_TRANSFER=y
CONFIG_ESP_HOSTED_MAX_CUSTOM_MSG_HANDLERS=32

# === SDIO host transport ===
# Explicitly select SDIO over the alternatives (SPI / SPI-HD / UART).
CONFIG_ESP_HOSTED_SDIO_HOST_INTERFACE=y
# CONFIG_ESP_HOSTED_SPI_HOST_INTERFACE is not set
# CONFIG_ESP_HOSTED_SPI_HD_HOST_INTERFACE is not set
# CONFIG_ESP_HOSTED_UART_HOST_INTERFACE is not set

CONFIG_ESP_HOSTED_SDIO_SLOT_0=y
CONFIG_ESP_HOSTED_SDIO_4_BIT_BUS=y
CONFIG_ESP_HOSTED_SDIO_CLOCK_FREQ_KHZ=40000

CONFIG_FREERTOS_HZ=1000
CONFIG_LOG_DEFAULT_LEVEL_INFO=y
```

## slave/components/phy_rpc_overlay/Kconfig.projbuild
```kconfig
menu "C5 V2X slave (PHY hack overlay)"

choice PHY_RPC_OVERLAY_CHANNEL
    prompt "ITS channel for the slave to lock to"
    default PHY_RPC_OVERLAY_CHANNEL_CCH
    config PHY_RPC_OVERLAY_CHANNEL_SCH2
        bool "SCH2 (172, 5860 MHz)"
    config PHY_RPC_OVERLAY_CHANNEL_SCH1
        bool "SCH1 (174, 5870 MHz)"
    config PHY_RPC_OVERLAY_CHANNEL_SCH4
        bool "SCH4 (178, 5890 MHz)"
    config PHY_RPC_OVERLAY_CHANNEL_CCH
        bool "CCH (180, 5900 MHz)"
    config PHY_RPC_OVERLAY_CHANNEL_SCH5
        bool "SCH5 (182, 5910 MHz)"
    config PHY_RPC_OVERLAY_CHANNEL_SCH6
        bool "SCH6 (184, 5920 MHz)"
endchoice

config PHY_RPC_OVERLAY_CHANNEL
    int
    default 172 if PHY_RPC_OVERLAY_CHANNEL_SCH2
    default 174 if PHY_RPC_OVERLAY_CHANNEL_SCH1
    default 178 if PHY_RPC_OVERLAY_CHANNEL_SCH4
    default 180 if PHY_RPC_OVERLAY_CHANNEL_CCH
    default 182 if PHY_RPC_OVERLAY_CHANNEL_SCH5
    default 184 if PHY_RPC_OVERLAY_CHANNEL_SCH6

config PHY_RPC_OVERLAY_REAPPLY_ON_WIFI_READY
    bool "Re-apply phy_11p_set on every WIFI_EVENT_WIFI_READY"
    default y
endmenu
```

## slave/sdkconfig.defaults
```kconfig
# Local overrides on top of upstream esp-hosted-mcu slave defaults.
CONFIG_IDF_TARGET="esp32c5"

# Disable upstream's app_main — our phy_rpc_overlay component provides one.
# CONFIG_ESP_HOSTED_COPROCESSOR_APP_MAIN is not set

# Enable the custom-data RPC channel (carries our phy_rpc_*_REQ/RESP/EVT msg_ids).
CONFIG_ESP_HOSTED_ENABLE_PEER_DATA_TRANSFER=y
CONFIG_ESP_HOSTED_MAX_CUSTOM_MSG_HANDLERS=16

# SDIO slave transport (matches the host's CONFIG_ESP_HOSTED_SDIO_HOST=y).
CONFIG_ESP_SDIO_HOST_INTERFACE=y

# We don't need the network-split / lwIP layer on the slave for our
# purposes — frames flow straight through esp-hosted's promiscuous path.
# CONFIG_ESP_HOSTED_NETWORK_SPLIT_ENABLED is not set

# 5 GHz band on
CONFIG_ESP_WIFI_5GHZ_ENABLED=y

# Bigger RX buffers; AMPDU off
CONFIG_ESP_WIFI_DYNAMIC_RX_BUFFER_NUM=64
CONFIG_ESP_WIFI_AMPDU_RX_ENABLED=n
CONFIG_ESP_WIFI_AMPDU_TX_ENABLED=n

CONFIG_FREERTOS_HZ=1000
CONFIG_LOG_DEFAULT_LEVEL_INFO=y

# Slave's stock partitions.esp32c5.csv expects a 4 MB chip.
CONFIG_ESPTOOLPY_FLASHSIZE_4MB=y
```
